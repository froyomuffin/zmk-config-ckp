## config/boards/shields/bt60_arrows/Kconfig.defconfig
```kconfig
if BT60_ARROWS_DONGLE

# Max 16 characters in keyboard name
config ZMK_KEYBOARD_NAME
    default "BT60 Arrows"

config ZMK_SPLIT_ROLE_CENTRAL
    default y

config ZMK_SPLIT
    default y

endif

if BT60_ARROWS

config ZMK_KEYBOARD_NAME
    default "BT60 Arrows Keyb"

config ZMK_SPLIT
    default y

config ZMK_BLE
    default y

if USB

config USB_NRFX
	default y

config USB_DEVICE_STACK
	default y

endif # USB

config BT_CTLR
	default BT

config ZMK_BATTERY_VOLTAGE_DIVIDER
	default y

endif
```

## config/boards/shields/bt60_arrows/Kconfig.shield
```kconfig
config BT60_ARROWS_DONGLE
    def_bool $(shields_list_contains,bt60_arrows_dongle)

config BT60_ARROWS
    def_bool $(shields_list_contains,bt60_arrows)
```
